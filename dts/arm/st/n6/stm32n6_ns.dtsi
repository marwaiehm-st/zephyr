/*
 * Copyright (c) 2024 STMicroelectronics
 *
 * SPDX-License-Identifier: Apache-2.0
 */

#include <st/n6/stm32n6.dtsi>

/ {
	soc {
		peripherals: peripherals@40000000 {
			#address-cells = <1>;
			#size-cells = <1>;
			ranges = <0x0 0x40000000 0x10000000>;

			/* Common STM32N6 peripherals description. */
			#include "stm32n6_peripherals.dtsi"
		};
	};
};
