/*
 * Copyright (c) 2024 STMicroelectronics
 *
 * SPDX-License-Identifier: Apache-2.0
 */
#include <mem.h>
#include <st/n6/stm32n657.dtsi>

/ {
	axisram1: memory@34000000 {
		reg = <0x34000000 DT_SIZE_K(1024)>;
	};
};
