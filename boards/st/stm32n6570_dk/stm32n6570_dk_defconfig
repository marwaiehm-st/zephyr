## boards/st/stm32n6570_dk/stm32n6570_dk_defconfig
```kconfig
# SPDX-License-Identifier: Apache-2.0
# Copyright (c) 2024 STMicroelectronics

# Enable UART driver
CONFIG_SERIAL=y

# Enable GPIO
CONFIG_GPIO=y

# Console
CONFIG_CONSOLE=y
CONFIG_UART_CONSOLE=y

# No internal Flash
CONFIG_XIP=n

CONFIG_ETH_STM32_HAL_RGMII=y
CONFIG_ETH_STM32_AUTO_NEGOTIATION_ENABLE=n
CONFIG_ETH_STM32_SPEED_1000M=y
```

## dts/bindings/ethernet/st,stm32-ethernet-parent.yaml
```yaml
# Copyright The Zephyr Project Contributors
# SPDX-License-Identifier: Apache-2.0

description: ST STM32 Ethernet parent node

compatible: "st,stm32-ethernet-parent"

include: base.yaml

properties:
  reg:
    required: true
  clocks:
    required: true
  clock-names:
    required: true
```

## samples/net/dhcpv4_client/sample.yaml
```yaml
sample:
  name: DHCP Client
tests:
  sample.net.dhcpv4_client:
    harness: console
    harness_config:
      type: multi_line
      regex:
        - "phy_mii: PHY (0) Link speed"
    platform_allow:
      - nucleo_h563zi
      - nucleo_h743zi
      - nucleo_f429zi
      - nucleo_f746zg
      - stm32h573i_dk
      - nucleo_f207zg
    tags:
      - net
      - http
```
