/*
 * Copyright (c) 2024 STMicroelectronics
 *
 * SPDX-License-Identifier: Apache-2.0
 */

/dts-v1/;
#include <st/n6/stm32n657x0hxq_s-pinctrl.dtsi>
#include <st/n6/stm32n657X0_s.dtsi>
#include "stm32n6570_dk_common.dtsi"
