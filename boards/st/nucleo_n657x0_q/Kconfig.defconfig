## boards/st/nucleo_n657x0_q/Kconfig.defconfig
```kconfig
# STM32N657X0_Q Nucleo board configuration

# Copyright (c) 2024 STMicroelectronics
# SPDX-License-Identifier: Apache-2.0

if BOARD_NUCLEO_N657X0_Q

config FLASH_LOAD_OFFSET
	default 0x70000000 if STM32N6_FSBL

endif # BOARD_NUCLEO_N657X0_Q
```

## boards/st/nucleo_n657x0_q/nucleo_n657x0_q_defconfig
```kconfig
# SPDX-License-Identifier: Apache-2.0
# Copyright (c) 2024 STMicroelectronics

# enable uart driver
CONFIG_SERIAL=y

# enable GPIO
CONFIG_GPIO=y

# Enable clock
CONFIG_CLOCK_CONTROL=y

# console
CONFIG_CONSOLE=y
CONFIG_UART_CONSOLE=y

# enable pin controller
CONFIG_PINCTRL=y

# For now store the program in RAM during flashing
CONFIG_XIP=n
CONFIG_FLASH_SIZE=0
CONFIG_FLASH_BASE_ADDRESS=0

CONFIG_DEBUG=y
```

## boards/st/stm32n6570_dk/Kconfig.defconfig
```kconfig
# STM32N6570 DK board configuration

# Copyright (c) 2024 STMicroelectronics
# SPDX-License-Identifier: Apache-2.0

if BOARD_STM32N6570_DK

config FLASH_LOAD_OFFSET
	default 0x70000000 if STM32N6_FSBL

endif # BOARD_STM32N6570_DK
```

## boards/st/stm32n6570_dk/board.yml
```yaml
board:
  name: stm32n6570_dk
  vendor: st
  socs:
    - name: stm32n657xx
      variants:
        - name: fsbl
```

## boards/st/stm32n6570_dk/stm32n6570_dk_fsbl_defconfig
```kconfig
# SPDX-License-Identifier: Apache-2.0

# enable uart driver
CONFIG_SERIAL=y

# enable GPIO
CONFIG_GPIO=y

# Enable clock
CONFIG_CLOCK_CONTROL=y

# console
CONFIG_CONSOLE=y
CONFIG_UART_CONSOLE=y

# enable pin controller
CONFIG_PINCTRL=y

# Enable MPU
CONFIG_ARM_MPU=y

# Enable HW stack protection
CONFIG_HW_STACK_PROTECTION=y

# Enable FSBL
CONFIG_STM32N6_FSBL=y

# For now store the program in RAM during flashing
CONFIG_XIP=n
CONFIG_FLASH_SIZE=0
CONFIG_FLASH_BASE_ADDRESS=0
```

## soc/st/stm32/stm32n6x/Kconfig
```kconfig
# ST Microelectronics STM32N6 MCU series

# Copyright (c) 2024 STMicroelectronics
# SPDX-License-Identifier: Apache-2.0

config SOC_SERIES_STM32N6X
	select ARM
	select CPU_CORTEX_M55
	select ARM_TRUSTZONE_M
	select CPU_HAS_ARM_SAU
	select CPU_HAS_ARM_MPU
	select CPU_HAS_FPU
	select CPU_HAS_ICACHE
	select CPU_HAS_DCACHE
	select ARMV8_M_DSP
	select CPU_CORTEX_M_HAS_DWT
	select HAS_STM32CUBE
	select INIT_ARCH_HW_AT_BOOT

config STM32N6_FSBL
	bool "Enable First Stage Boot Loader Mode"
	select PLATFORM_SPECIFIC_INIT
	select TRUSTED_EXECUTION_SECURE

config STM32N6_FSBL_DEBUG
	bool "FSBL specific debug flag"
	help
	  Enable to debug FSBL application

config STM32N6_CUT1
	bool "Enable Cut1 compatible code"
	help
	  Temporary. DNM
```

## soc/st/stm32/stm32n6x/Kconfig.defconfig
```kconfig
# ST Microelectronics STM32N6 MCU series

# Copyright (c) 2024 STMicroelectronics
# SPDX-License-Identifier: Apache-2.0

if SOC_SERIES_STM32N6X

rsource "Kconfig.defconfig.stm32n6*"

endif # SOC_SERIES_STM32N6X
```
