/*
 * Copyright (c) 2024 STMicroelectronics
 * SPDX-License-Identifier: Apache-2.0
 */

#include <zephyr/dt-bindings/gpio/gpio.h>
#include <zephyr/dt-bindings/gpio/st-morpho-header.h>

/ {
	st_morpho_header: st-morpho-header {
		compatible = "st-morpho-header";
		#gpio-cells = <2>;
		gpio-map-mask = <ST_MORPHO_PIN_MASK 0x0>;
		gpio-map-pass-thru = <0x0 GPIO_DT_FLAGS_MASK>;
		gpio-map = <ST_MORPHO_L_9 0 &gpioh 0 0>,
			   <ST_MORPHO_L_11 0 &gpioh 1 0>,
			   <ST_MORPHO_L_15 0 &gpioc 5 0>,
			   <ST_MORPHO_L_17 0 &gpioc 0 0>,
			   <ST_MORPHO_L_21 0 &gpioe 4 0>,
			   <ST_MORPHO_L_23 0 &gpioc 2 0>,
			   <ST_MORPHO_L_25 0 &gpioc 3 0>,
			   <ST_MORPHO_L_26 0 &gpioh 4 0>,
			   <ST_MORPHO_L_27 0 &gpioc 15 0>,
			   <ST_MORPHO_L_28 0 &gpiof 5 0>,
			   <ST_MORPHO_L_29 0 &gpioc 14 0>,
			   <ST_MORPHO_L_30 0 &gpioc 10 0>,
			   <ST_MORPHO_L_32 0 &gpiof 6 0>,
			   <ST_MORPHO_L_34 0 &gpioc 12 0>,
			   <ST_MORPHO_L_35 0 &gpioa 6 0>,
			   <ST_MORPHO_L_36 0 &gpioa 2 0>,
			   <ST_MORPHO_L_37 0 &gpioc 8 0>,
			   <ST_MORPHO_L_38 0 &gpioh 2 0>,
			   <ST_MORPHO_R_1 0 &gpioe 12 0>,
			   <ST_MORPHO_R_2 0 &gpioe 6 0>,
			   <ST_MORPHO_R_3 0 &gpioh 9 0>,
			   <ST_MORPHO_R_4 0 &gpioe 5 0>,
			   <ST_MORPHO_R_5 0 &gpioc 1 0>,
			   <ST_MORPHO_R_6 0 &gpiod 6 0>,
			   <ST_MORPHO_R_11 0 &gpioe 15 0>,
			   <ST_MORPHO_R_12 0 &gpiob 3 0>,
			   <ST_MORPHO_R_13 0 &gpiog 1 0>,
			   <ST_MORPHO_R_14 0 &gpiob 8 0>,
			   <ST_MORPHO_R_15 0 &gpiog 2 0>,
			   <ST_MORPHO_R_16 0 &gpiob 9 0>,
			   <ST_MORPHO_R_17 0 &gpioa 3 0>,
			   <ST_MORPHO_R_18 0 &gpiob 14 0>,
			   <ST_MORPHO_R_19 0 &gpiod 7 0>,
			   <ST_MORPHO_R_21 0 &gpiod 12 0>,
			   <ST_MORPHO_R_22 0 &gpioe 7 0>,
			   <ST_MORPHO_R_23 0 &gpioe 11 0>,
			   <ST_MORPHO_R_24 0 &gpioe 1 0>,
			   <ST_MORPHO_R_25 0 &gpiod 5 0>,
			   <ST_MORPHO_R_26 0 &gpioe 14 0>,
			   <ST_MORPHO_R_27 0 &gpioe 10 0>,
			   <ST_MORPHO_R_28 0 &gpioe 13 0>,
			   <ST_MORPHO_R_29 0 &gpioe 0 0>,
			   <ST_MORPHO_R_30 0 &gpioe 2 0>,
			   <ST_MORPHO_R_31 0 &gpioe 9 0>,
			   <ST_MORPHO_R_33 0 &gpiod 0 0>,
			   <ST_MORPHO_R_34 0 &gpioa 0 0>,
			   <ST_MORPHO_R_35 0 &gpiod 8 0>,
			   <ST_MORPHO_R_37 0 &gpiod 9 0>,
			   <ST_MORPHO_R_38 0 &gpioa 1 0>;
	};
};
